#ifndef F_CPU
#define F_CPU 8000000UL
#endif

#include <avr/io.h>
#include <avr/pgmspace.h>
#include <util/delay.h>
#include "oled.h"

/* ================================================================
 * DIRECCION I2C DEL SSD1306
 * La mayoria de modulos 0.96" de China usan 0x3C.
 * Si no responde, prueba 0x3D (depende del pad SA0 en el modulo).
 * ================================================================ */
#define OLED_ADDR  0x3C

/* ================================================================
 * FUENTE 5x8 ASCII 32-126
 * Guardada en PROGMEM (flash) para no ocupar RAM.
 * Cada caracter son 5 bytes = 5 columnas de 8 pixeles.
 * Bit 0 de cada byte = pixel mas alto de esa columna.
 * ================================================================ */
static const uint8_t font[][5] PROGMEM = {
    {0x00,0x00,0x00,0x00,0x00}, /* 32   */
    {0x00,0x00,0x5F,0x00,0x00}, /* 33 ! */
    {0x00,0x07,0x00,0x07,0x00}, /* 34 " */
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    {0x08,0x08,0x2A,0x1C,0x08}, /* 126 ~ */
};

/* ================================================================
 * TWI (I2C) - hardware del ATmega328P
 * SDA = PC4, SCL = PC5 (pines fisicos 27 y 28 del DIP28)
 *
 * TWBR controla la velocidad del bus:
 * SCL = F_CPU / (16 + 2*TWBR*4^TWPS)
 * Con F_CPU=8MHz, TWBR=32, TWPS=0: SCL = 8M/(16+64) = 100kHz
 * ================================================================ */
static void twi_start(uint8_t addr)
{
    /* Genera condicion START y envia direccion del esclavo.
     * addr debe ir con el bit R/W incluido: addr<<1 para write. */
    TWCR = (1<<TWINT)|(1<<TWSTA)|(1<<TWEN);
    while(!(TWCR & (1<<TWINT)));   /* espera fin de START */
    TWDR = addr;
    TWCR = (1<<TWINT)|(1<<TWEN);
    while(!(TWCR & (1<<TWINT)));   /* espera ACK de esclavo */
}

static void twi_byte(uint8_t b)
{
    /* Envia un byte y espera ACK. TWINT se limpia escribiendo 1. */
    TWDR = b;
    TWCR = (1<<TWINT)|(1<<TWEN);
    while(!(TWCR & (1<<TWINT)));
}

static void twi_stop(void)
{
    /* Genera condicion STOP. TWSTO se limpia solo por hardware. */
    TWCR = (1<<TWINT)|(1<<TWSTO)|(1<<TWEN);
}

/* ================================================================
 * SSD1306 - helpers internos
 *
 * Protocolo I2C del SSD1306:
 * [START][dir_esclavo][byte_control][datos...][STOP]
 *
 * Byte de control:
 *   0x00 = lo que sigue es un unico comando
 *   0x40 = lo que sigue es un stream de datos para el framebuffer
 * ================================================================ */
static void ssd_cmd(uint8_t c)
{
    twi_start(OLED_ADDR << 1);
    twi_byte(0x00);
    twi_byte(c);
    twi_stop();
}

/* ================================================================
 * API PUBLICA
 * ================================================================ */

void oled_init(void)
{
    /* TWBR=32 -> 100kHz @ 8MHz. TWSR bits 0-1 = prescaler = 00 = 1x */
    TWBR = 32;
    TWSR = 0x00;

    _delay_ms(100);  /* espera que el SSD1306 termine su power-on reset */

    ssd_cmd(0xAE);          /* display off durante configuracion */
    ssd_cmd(0xD5); ssd_cmd(0x80); /* clock: divide ratio=1, oscilador=8 */
    ssd_cmd(0xA8); ssd_cmd(0x3F); /* multiplex 1:64 (para 64 filas) */
    ssd_cmd(0xD3); ssd_cmd(0x00); /* display offset = 0 filas */
    ssd_cmd(0x40);               /* start line = linea 0 */
    ssd_cmd(0x8D); ssd_cmd(0x14); /* charge pump interna habilitada */
    ssd_cmd(0x20); ssd_cmd(0x00); /* modo de direccionamiento horizontal:
                                    col avanza 0->127, luego page avanza */
    ssd_cmd(0xA1);          /* segment remap: columna 127 -> SEG0 (espejo H) */
    ssd_cmd(0xC8);          /* COM scan invertido (espejo V) */
    ssd_cmd(0xDA); ssd_cmd(0x12); /* COM pins: alternado, sin remap */
    ssd_cmd(0x81); ssd_cmd(0xCF); /* contraste */
    ssd_cmd(0xD9); ssd_cmd(0xF1); /* pre-charge period */
    ssd_cmd(0xDB); ssd_cmd(0x40); /* VCOMH deselect level */
    ssd_cmd(0xA4);          /* muestra contenido de GDDRAM (no fuerza todo ON) */
    ssd_cmd(0xA6);          /* display normal (no invertido) */
    ssd_cmd(0xAF);          /* display ON */
}

void oled_clear(void)
{
    /* Apunta a toda la pantalla: columnas 0-127, paginas 0-7 */
    ssd_cmd(0x21); ssd_cmd(0x00); ssd_cmd(0x7F);
    ssd_cmd(0x22); ssd_cmd(0x00); ssd_cmd(0x07);

    /* Envia 1024 bytes (128 col x 8 pages) de ceros en una sola
     * transaccion I2C. El byte 0x40 le dice al SSD1306 que lo que
     * sigue es un stream de datos para el framebuffer. */
    twi_start(OLED_ADDR << 1);
    twi_byte(0x40);
    for(uint16_t i = 0; i < 1024; i++)
        twi_byte(0x00);
    twi_stop();
}

void oled_goto(uint8_t col, uint8_t page)
{
    /* Fija la ventana de escritura. En modo horizontal el cursor
     * avanza automaticamente columna a columna, page a page. */
    ssd_cmd(0x21); ssd_cmd(col);  ssd_cmd(0x7F);
    ssd_cmd(0x22); ssd_cmd(page); ssd_cmd(0x07);
}

void oled_char(char c)
{
    if(c < 32 || c > 126) c = ' ';
    twi_start(OLED_ADDR << 1);
    twi_byte(0x40);
    for(uint8_t i = 0; i < 5; i++)
        twi_byte(pgm_read_byte(&font[(uint8_t)(c - 32)][i]));
    twi_byte(0x00);   /* columna vacia de separacion entre caracteres */
    twi_stop();
}

void oled_str(const char *s)
{
    /* Una sola transaccion I2C para toda la cadena: mas eficiente
     * que abrir/cerrar el bus por cada caracter. */
    twi_start(OLED_ADDR << 1);
    twi_byte(0x40);
    while(*s) {
        uint8_t idx = (uint8_t)(*s - 32);
        if(*s < 32 || *s > 126) idx = 0;
        for(uint8_t i = 0; i < 5; i++)
            twi_byte(pgm_read_byte(&font[idx][i]));
        twi_byte(0x00);
        s++;
    }
    twi_stop();
}